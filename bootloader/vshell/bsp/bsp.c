/**
*******************************************************************************************************
*			 			 				命令中断shell底层输入输出接口								 
*                      			  (c) Copyright 2013-2020, xxx公司, 广州
*                              				All Rights Reserved
*  
* 
* @文件名	bsp.c
* @作者  		 
* @版本 	V1.0
* @日期    	2017-09-06
* @说明   	实现板级输入输出接口的封装
*******************************************************************************************************
* @注意事项
*
*******************************************************************************************************
* @修改记录
*
*******************************************************************************************************
*/
/* Includes -----------------------------------------------------------------------------------------*/
#include "bsp.h"
#include "bsp_systick.h"
#include "system_stm32f10x.h"
#include "vshell.h"


/*
*********************************************************************************************************
*                                        	字符接收接口
*
* 描述  : 对板级的串口接收字符接口进行封装，供命令终端shell调用。
*
* 参数  : 无
*
* 返回值: 字符相应的ASCALL值
*
* 备注  : 若需要通过检测通信是否断开，需在while循环中进行检测。	
*********************************************************************************************************
*/
char vshell_getc(void)
{	
	while(!(USART1->SR&(1<<5)));		/* 接收数据寄存器空，等待数据到来				*/
	return USART1->DR; 		  							/* 读取数据，并返回	 							*/
} 


unsigned char tstc(void)
{
	int retry = 0;
	while(!(USART1->SR&(1<<5)) && retry < 10)		/* 接收数据寄存器空，等待数据到来				*/
	{
		retry++;
		delay_ms(1); 
	}
	 
	if(retry >= 10)
		return 0;
	else
		USART1->DR;
	return 1;															
}

/*
*********************************************************************************************************
*                                        	字符发送接口
*
* 描述  : 对板级的串口发送字符接口进行封装，供命令终端shell调用。
*
* 参数  : c			需要发送字符对应ASCALL值
*
* 返回值: 无
*
* 备注  : 无	
*********************************************************************************************************
*/
void vshell_putc(char c)
{
	while(!(USART1->SR & 0X40));		/* 发送数据寄存器非空,等待上次数据发送完						*/
	USART1->DR = c;
}



